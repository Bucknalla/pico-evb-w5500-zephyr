## west.yml
```yaml
manifest:
  version: 0.7

  defaults:
    remote: zephyrproject

  remotes:
    - name: zephyrproject
      url-base: https://github.com/zephyrproject-rtos

  projects:
    - name: zephyr
      revision: main
      west-commands: scripts/west-commands.yml
      import:
        name-allowlist:
          - cmsis
          - hal_rpi_pico
    - name: note-zephyr
      path: modules/note-zephyr
      revision: main
      submodules: true
      url: https://github.com/blues/note-zephyr

  self:
    path: app
```
